## conf/distro/aos-vm-dev.conf
```bitbake
include conf/distro/poky.conf

DISTRO = "aos-vm-dev"
DISTRO_NAME = "Aos development VM"
SDK_VENDOR = "-aossdk"
SDK_VERSION="${DISTRO_VERSION}"

TARGET_VENDOR = "-aosvm"

DISTROOVERRIDES = "aosvm"

# Add systemd configuration
INIT_MANAGER = "systemd"

# Initramfs configuration
INITRAMFS_IMAGE = "core-image-tiny-initramfs"
INITRAMFS_IMAGE_BUNDLE = "0"
INITRAMFS_FSTYPES = "cpio.gz"

# Configure log dir to be stored in persistent storage
VOLATILE_LOG_DIR = "no"

# Do not update fstab in wic
WIC_CREATE_EXTRA_ARGS ?= "--no-fstab-update"

# SELinux config
DISTRO_FEATURES_append = " pam selinux"
PREFERRED_PROVIDER_virtual/refpolicy = "refpolicy-aos"

# runc provider
PREFERRED_PROVIDER_virtual/runc = "runc-opencontainers"
```

## meta-aos-vm-common/conf/distro/aos-vm-dev.conf
```bitbake
include conf/distro/poky.conf

DISTRO = "aos-vm-dev"
DISTRO_NAME = "Aos development VM"
SDK_VENDOR = "-aossdk"
SDK_VERSION="${DISTRO_VERSION}"

TARGET_VENDOR = "-aosvm"

DISTROOVERRIDES = "aosvm"

# Add systemd configuration
INIT_MANAGER = "systemd"

# Initramfs configuration
INITRAMFS_IMAGE = "aos-image-initramfs"
INITRAMFS_IMAGE_BUNDLE = "0"
INITRAMFS_FSTYPES = "cpio.gz"

# Configure log dir to be stored in persistent storage
VOLATILE_LOG_DIR = "no"

# SELinux config
DISTRO_FEATURES:append = " acl xattr pam selinux"
# Enable security
DISTRO_FEATURES:append = " security"

# refpolicy
PREFERRED_PROVIDER_virtual/refpolicy = "refpolicy-aos"

# runc provider
PREFERRED_PROVIDER_virtual/runc = "runc-opencontainers"

# Disk configuration

AOS_IMAGE_DISK = "sda"
ROOT_HOME = "/home/root"
```

## meta-aos-vm-common/conf/distro/aos-vm.conf
```bitbake
include conf/distro/poky.conf

DISTRO = "aos-vm"
DISTRO_NAME = "Aos VM"
DISTRO_VERSION = "${AOS_ROOTFS_IMAGE_VERSION}"
SDK_VENDOR = "-aosvmsdk"
SDK_VERSION="${AOS_ROOTFS_IMAGE_VERSION}"
SDK_VERSION[vardepvalue] = "${AOS_ROOTFS_IMAGE_VERSION}"
SDK_NAME = "${DISTRO}-${SDKMACHINE}"
SDKPATHINSTALL = "/opt/${DISTRO}-sdk/${SDK_VERSION}"
TOOLCHAIN_OUTPUTNAME = "${SDK_NAME}-toolchain-${MACHINE}-${SDK_VERSION}"
TARGET_VENDOR = "-aosvm"
DISTROOVERRIDES = "aosvm"

# Add systemd configuration
INIT_MANAGER = "systemd"

# Initramfs configuration
INITRAMFS_IMAGE = "aos-image-initramfs"
INITRAMFS_IMAGE_BUNDLE = "0"
INITRAMFS_FSTYPES = "cpio.gz"

# Configure log dir to be stored in persistent storage
VOLATILE_LOG_DIR = "no"

# SELinux config
DISTRO_FEATURES:append = " acl xattr pam selinux"
# Enable security
DISTRO_FEATURES:append = " security"

# refpolicy
PREFERRED_PROVIDER_virtual/refpolicy = "refpolicy-aos"

# runc provider
PREFERRED_PROVIDER_virtual/runc = "runc-opencontainers"

# Enable debug tools
EXTRA_IMAGE_FEATURES:append = " tools-debug"

# Disk configuration

AOS_IMAGE_DISK = "sda"
ROOT_HOME = "/home/root"
```

## meta-aos-vm-common/conf/layer.conf
```bitbake
# We have a conf and classes directory, add to BBPATH
BBPATH .= ":${LAYERDIR}"

# We have a packages directory, add to BBFILES
BBFILES += "${LAYERDIR}/recipes-*/*/*.bb \
            ${LAYERDIR}/recipes-*/*/*.bbappend"

BBFILE_COLLECTIONS += "aos-vm-common"
BBFILE_PATTERN_aos-vm-common := "^${LAYERDIR}/"
BBFILE_PRIORITY_aos-vm-common = "12"

LAYERSERIES_COMPAT_aos-vm-common = "dunfell"
```

## meta-aos-vm-main/conf/layer.conf
```bitbake
# We have a conf and classes directory, add to BBPATH
BBPATH .= ":${LAYERDIR}"

# We have a packages directory, add to BBFILES
BBFILES += "${LAYERDIR}/recipes-*/*/*.bb \
            ${LAYERDIR}/recipes-*/*/*.bbappend"

BBFILE_COLLECTIONS += "aos-vm-main"
BBFILE_PATTERN_aos-vm-main := "^${LAYERDIR}/"
BBFILE_PRIORITY_aos-vm-main = "14"

LAYERSERIES_COMPAT_aos-vm-main = "dunfell"
```

## meta-aos-vm-node/conf/layer.conf
```bitbake
# We have a conf and classes directory, add to BBPATH
BBPATH .= ":${LAYERDIR}"

# We have a packages directory, add to BBFILES
BBFILES += "${LAYERDIR}/recipes-*/*/*.bb \
            ${LAYERDIR}/recipes-*/*/*.bbappend"

BBFILE_COLLECTIONS += "aos-vm-node"
BBFILE_PATTERN_aos-vm-node := "^${LAYERDIR}/"
BBFILE_PRIORITY_aos-vm-node = "14"

LAYERSERIES_COMPAT_aos-vm-node = "dunfell kirkstone scarthgap"
```

## wic/aos-minimal.wks
```
# short-description: Create an EFI disk image for genericx86*
# long-description: Creates a partitioned EFI disk image for genericx86* machines
part /boot --source bootimg-efi --sourceparams="loader=grub-efi,initrd=core-image-tiny-initramfs-genericx86-64.cpio.gz" --ondisk hda --label msdos --active --align 1024
part / --source rootfs --ondisk hda --fstype=ext4 --label platform --align 1024 --size 1024M
part /var --source rootfs --rootfs-dir=${IMAGE_ROOTFS}/var --ondisk hda --fstype=ext4 --label aos --align 1024 --size 2048M --fsoptions="defaults,usrjquota=aquota.user,jqfmt=vfsv0"
part swap --ondisk hda --size 44 --label swap1 --fstype=swap

bootloader --ptable gpt --timeout=5 --append="root=/dev/hda2 ro userdata=/dev/hda3 rootfstype=ext4 console=tty0"
```
